## hardware/lot-tile/firmware/main/Kconfig.projbuild
```kconfig
menu "LOT TILE"
config LOT_API_HOST
    string "LOT API base URL"
    default "https://lot-systems.com/api/device/v1"
config LOT_DEFAULT_LIVE_MODE
    bool "Default to Live mode (Wi-Fi kept associated)"
    default n
config LOT_MAX_SLEEP_S
    int "Maximum sleep between syncs (seconds)"
    default 10800
endmenu
```

## hardware/lot-tile/firmware/sdkconfig.defaults
```kconfig
CONFIG_IDF_TARGET="esp32s3"
CONFIG_ESPTOOLPY_FLASHSIZE_4MB=y
CONFIG_SPIRAM=y
CONFIG_PARTITION_TABLE_CUSTOM=y
CONFIG_PARTITION_TABLE_CUSTOM_FILENAME="partitions.csv"
CONFIG_ESP_TLS_CLIENT_SESSION_TICKETS=y
CONFIG_MBEDTLS_CLIENT_SSL_SESSION_TICKETS=y
CONFIG_PM_ENABLE=y
CONFIG_ESP_WIFI_STA_DISCONNECTED_PM_ENABLE=y
CONFIG_BOOTLOADER_APP_ROLLBACK_ENABLE=y
```
