// LOT API connector — device side. Protocol: docs/06-LOT-API-CONNECTOR.md
#include "lot_api.h"
#include "config.h"
#include <ArduinoJson.h>
#include <HTTPClient.h>
#include <WiFiClientSecure.h>

// Root CA for lot-systems.com (Let's Encrypt ISRG Root X1). Generated by
// hardware/lot-tile/tools/fetch_root_ca.sh into include/root_ca.h. Until it
// exists, only DEVKIT builds may connect without verification.
#if __has_include("root_ca.h")
#include "root_ca.h"
#define LOT_HAVE_ROOT_CA 1
#endif

static void configureTls(WiFiClientSecure& c) {
#ifdef LOT_HAVE_ROOT_CA
  c.setCACert(LOT_ROOT_CA_PEM);
#else
  if (String(LOT_HW_REV) == "DEVKIT") {
    log_w("TLS verification DISABLED (no root_ca.h) — devkit only");
    c.setInsecure();
  }
  // EVT/PVT builds without a CA fail closed: the handshake is rejected.
#endif
}

void LotApi::begin(const String& host, const String& serial, const String& token) {
  host_ = host;
  serial_ = serial;
  token_ = token;
}

int LotApi::postJson(const char* path, const String& body, String& resp, bool auth) {
  WiFiClientSecure client;
  configureTls(client);
  HTTPClient http;
  http.setTimeout(8000);
  if (!http.begin(client, host_ + LOT_API_PREFIX + path)) return -1;
  http.addHeader("Content-Type", "application/json");
  http.addHeader("User-Agent", "LOT-TILE/" LOT_FW_VERSION " (" LOT_HW_REV ")");
  if (auth && token_.length()) http.addHeader("Authorization", "Bearer " + token_);
  int code = http.POST(body);
  if (code > 0) resp = http.getString();
  http.end();
  return code;
}

int LotApi::getJson(const String& pathAndQuery, String& resp) {
  WiFiClientSecure client;
  configureTls(client);
  HTTPClient http;
  http.setTimeout(8000);
  if (!http.begin(client, host_ + LOT_API_PREFIX + pathAndQuery)) return -1;
  http.addHeader("User-Agent", "LOT-TILE/" LOT_FW_VERSION " (" LOT_HW_REV ")");
  http.addHeader("Authorization", "Bearer " + token_);
  int code = http.GET();
  if (code > 0) resp = http.getString();
  http.end();
  return code;
}

bool LotApi::registerDevice(String& pairCodeOut, uint32_t& expiresS) {
  JsonDocument req;
  req["serial"] = serial_;
  req["hw_rev"] = LOT_HW_REV;
  req["fw"] = LOT_FW_VERSION;
  String body, resp;
  serializeJson(req, body);
  if (postJson("/register", body, resp, false) != 200) return false;
  JsonDocument doc;
  if (deserializeJson(doc, resp)) return false;
  pairCodeOut = doc["pair_code"] | "";
  expiresS = doc["expires_s"] | 600;
  return pairCodeOut.length() > 0;
}

bool LotApi::pollPair(const String& pairCode, String& tokenOut, String& nameOut) {
  JsonDocument req;
  req["serial"] = serial_;
  req["pair_code"] = pairCode;
  String body, resp;
  serializeJson(req, body);
  if (postJson("/pair/poll", body, resp, false) != 200) return false;
  JsonDocument doc;
  if (deserializeJson(doc, resp)) return false;
  const char* tok = doc["token"] | "";
  if (!*tok) return false;  // still pending
  tokenOut = tok;
  nameOut = doc["name"] | "";
  token_ = tokenOut;
  return true;
}

LotSyncResult LotApi::sync(const String& cursor) {
  LotSyncResult r;
  String resp;
  String q = "/sync";
  if (cursor.length()) q += "?since=" + cursor;
  r.httpStatus = getJson(q, resp);
  if (r.httpStatus != 200) return r;
  JsonDocument doc;
  if (deserializeJson(doc, resp)) return r;
  r.ok = true;
  r.cursor = doc["cur"] | cursor.c_str();
  r.nextPollS = doc["next_poll_s"] | 0;
  JsonArray n = doc["n"].as<JsonArray>();
  if (!n.isNull() && n.size() > 0) {
    JsonObject last = n[n.size() - 1];  // newest last; pager shows only the newest
    r.latest.id = last["id"] | "";
    r.latest.text = String((const char*)(last["t"] | "")).substring(0, LOT_NOTIFY_MAX_CHARS);
    r.latest.kind = last["k"] | "nudge";
    r.latest.ts = last["ts"] | 0;
    r.hasNew = r.latest.id.length() > 0;
  }
  return r;
}

bool LotApi::copy(const String& notificationId) {
  JsonDocument req;
  req["nid"] = notificationId;
  String body, resp;
  serializeJson(req, body);
  return postJson("/copy", body, resp) == 200;
}

bool LotApi::telemetry(const LotTelemetry& t) {
  JsonDocument req;
  req["tc"] = roundf(t.tempC * 10) / 10;
  req["rh"] = roundf(t.rh);
  req["hpa"] = roundf(t.hPa * 10) / 10;
  req["iaq"] = roundf(t.iaq);
  req["gc"] = t.gasClass;
  req["lux"] = t.lux;
  req["bat"] = t.batteryPct;
  req["rssi"] = t.rssi;
  String body, resp;
  serializeJson(req, body);
  return postJson("/telemetry", body, resp) == 200;
}

bool LotApi::photo(const String& notificationId, const uint8_t* jpeg, size_t len) {
  if (len > LOT_PHOTO_MAX_BYTES) return false;
  // Raw JPEG body; notification id in a header keeps the device free of multipart encoding.
  WiFiClientSecure client;
  configureTls(client);
  HTTPClient http;
  http.setTimeout(15000);
  if (!http.begin(client, host_ + LOT_API_PREFIX + "/photo")) return false;
  http.addHeader("Content-Type", "image/jpeg");
  http.addHeader("Authorization", "Bearer " + token_);
  http.addHeader("X-LOT-Notification", notificationId);
  int code = http.POST(const_cast<uint8_t*>(jpeg), len);
  http.end();
  return code == 200;
}
